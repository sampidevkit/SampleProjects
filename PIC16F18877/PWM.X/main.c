#include "mcc_generated_files/mcc.h"
#include <math.h>
#define membersof(a) ((ssize_t)(sizeof(a)/sizeof((a)[0])))

static const uint16_t duty[]={
    0, 0, 0, 839, 845, 797, 754, 774, 851, 913, 890, 790, 701, 712, 821, 929,
    930, 813, 680, 655, 768, 918, 963, 853, 683, 608, 702, 883, 982, 901, 708,
    577, 633, 827, 981, 948, 751, 568, 568, 755, 958, 986, 807, 581, 516, 673,
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    839, 0, 0, 0
};

void main(void)
{
    bool code_gen=1;
    SYSTEM_Initialize();

    while(1)
    {
#if(0)
        float y0, y1, y2, y3, y4;
        float x, res1, res2, res3;

        /* y=sqrt(cos(x))*cos(100*x)+(sqrt(abs(x))-0.7)*pow((8-x*x),0.01)+1.54
           x=-2.00:0.01:2.00         */
        RLED_SetLow();

        if(code_gen)
            printf("\n\nA=[");

        for(x=-1.6f; x<1.6f; x+=0.01f)
        {
            y0=cos(x);
            y1=sqrt(y0);
            y2=cos(x*100.0f);
            res1=y1*y2;

            if(x<0.0f)
                y0=(-1.0f)*x;
            else
                y0=x;

            y1=sqrt(y0)-0.7f;
            y3=8.0f-x*x;
            y4=pow(y3, 0.01f);
            res2=y1*y4;
            res3=res1+res2+1.54f;

            // Convert to PWM duty
            res3/=2.6f;
            res3*=1024.0f;
            PWM6_LoadDutyValue((uint16_t) res3);

            if(code_gen)
                printf("%d ", (uint16_t) res3);
            //__delay_ms(10);
        }

        if(code_gen)
        {
            code_gen=0;
            printf("];\nplot(A);");
        }
#else
        uint16_t i, sz;

        RLED_SetLow();
        sz=membersof(duty);
        //printf("\n%d", sz);

        for(i=0; i<sz; i++)
        {
            PWM6_LoadDutyValue(duty[i]);
            __delay_ms(10);
        }
#endif

        RLED_SetHigh();
        __delay_ms(100);
    }
}